// SPDX-License-Identifier: (GPL-2.0-only OR BSD-2-Clause)
/*
 * Google Pixel 9 Pro (caiman).
 *
 * Copyright 2025 Trijal Saha <trijalsaha2012@gmail.com>
 */

/dts-v1/;

#include "zumapro.dtsi"

/ {
	model = "Google Pixel 9 Pro (caiman)";
	compatible = "google,caiman", "google,zumapro-caiman", "google,zumapro";
};

&framebuffer0 {
	width = <1280>;
	height = <2856>;
	stride = <(1280 * 4)>;
	status = "okay";
};
