// SPDX-License-Identifier: (GPL-2.0-only OR BSD-2-Clause)
/*
 * Google Pixel 9 Pro Fold (comet).
 *
 * Copyright 2025 Trijal Saha <trijalsaha2012@gmail.com>
 */

/dts-v1/;

#include "zumapro.dtsi"

/ {
	model = "Google Pixel 9 Pro Fold (comet)";
	compatible = "google,comet", "google,zumapro-comet", "google,zumapro";
};

&framebuffer0 {
	width = <2076>;
	height = <2152>;
	stride = <(2076 * 4)>;
	status = "okay";
};
