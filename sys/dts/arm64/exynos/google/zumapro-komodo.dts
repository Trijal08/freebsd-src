// SPDX-License-Identifier: (GPL-2.0-only OR BSD-2-Clause)
/*
 * Google Pixel 9 Pro XL (komodo).
 *
 * Copyright 2025 Trijal Saha <trijalsaha2012@gmail.com>
 */

/dts-v1/;

#include "zumapro.dtsi"

/ {
	model = "Google Pixel 9 Pro XL (komodo)";
	compatible = "google,komodo", "google,zumapro-komodo", "google,zumapro";
};

&framebuffer0 {
	width = <1344>;
	height = <2992>;
	stride = <(1344 * 4)>;
	status = "okay";
};
