// SPDX-License-Identifier: (GPL-2.0-only OR BSD-2-Clause)
/*
 * Google Pixel 9 (tokay).
 *
 * Copyright 2025 Trijal Saha <trijalsaha2012@gmail.com>
 */

/dts-v1/;

#include "zumapro.dtsi"

/ {
	model = "Google Pixel 9 (tokay)";
	compatible = "google,tokay", "google,zumapro-tokay", "google,zumapro";
};

&framebuffer0 {
	width = <1080>;
	height = <2424>;
	stride = <(1080 * 4)>;
	status = "okay";
};
